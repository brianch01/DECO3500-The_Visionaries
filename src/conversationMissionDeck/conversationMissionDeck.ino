// This code was adapted from the code generated by Sherwin Ramos 
// and a response by chatGPT, please see the Reference section on the Github WIKI for details of prompt and answer
// https://arduinointro.com/articles/projects/make-interactive-arduino-projects-using-pushbutton-and-lcd?fbclid=IwY2xjawGByA5leHRuA2FlbQIxMAABHWQgB7nqd9BUjosvj_TjkX2raWTvuZ6ifeCPn874E3Ccv5iNPleqjVR02Q_aem_8nSdBQ6_1JoiGOLWLmg2cg

#include <Wire.h>
#include <LiquidCrystal.h>


LiquidCrystal lcd(10, 9, 7, 6, 5, 4);


int switchPromptPin = 2; //button connected to digital pin 2
int switchPrompt1Index = 0; //determines which prompt in the array is shown on screen
int switchPrompt2Index = 0; //for Set 2 prompts
int switchPrompt3Index = 0; //for Set 3 prompts
int switchPromptState = 0; //tells whether button is pressed or not


int switchMissionPin = 8;
int switchMission1Index = 0; //determines which mission in the array is shown on screen
int switchMission2Index = 0; //for Set 2 missions
int switchMission3Index = 0; //for Set 3 missions
int switchMissionState = 0;


int switchSet1Pin = 13; //Set 1 button connected to digital pin 13
int switchSet1State = 0; //tells whether a Set changing button is pressed or not
int switchSet2Pin = 12;
int switchSet2State = 0;
int switchSet3Pin = 11;
int switchSet3State = 0;


int switchSetValue = 0; //variable to determine which Set you're using


// COEX Mall, Seoul, Korea 4pm
const char* prompts1[] = {  
  " What local experience in Seoul do you think is a must-try and why?",
  " Which street food in Seoul are you most excited to try this afternoon?",
  " Where do you think is the best place to watch the sunset in Seoul?", 
  " Name 3 activities you want to do tonight in Seoul"
};


const char* missions1[] = {
  " Challenge someone to order in Korean at a restaurant or café.",
  " Seek out a themed café (like a dog café) and take a fun group photo",
  " Have someone do a K-pop dance move in public",
 " Have everyone participate in a famous tiktok dance"
  
};


// sydney 10:03am at Opera house
const char* prompts2[] = {
  " What food do you think everyone would love to try for lunch?",
  " What's your favorite part about exploring cities like Sydney?",
  " What's one thing you wish to do in Sydney",
  " Top 3 locations you want to visit in Sydney today and why?",
};


const char* missions2[] = {
  " Take everyone to the best sunset view near the Opera House",
  " Have everyone take a group selfie for every new stop",
  " Get the group to take a photo with someone wearing a sydney-themed shirt",
  " Create a funny group video featuring iconic Sydney landmarks",
};


//Shinjuku, Tokyo, Japan 7:04pm
const char* prompts3[] = {
  " Which street food are you most excited to try at night?",
  " top 3 things you want to do tonight and why",
  " What dessert or sweet treat from Tokyo are you looking forward to enjoying?",
  " Which aspect of Tokyo's nightlife do you have to try?"
};


const char* missions3[] = {
  " Challenge someone to try the spiciest dish on the menu",
  " Create a funny group video reenacting a scene from a Japanese movie",
  " Explore a night market and get everyone to share a snack",
  " Get everyone to take photo in front of 8 neon signs",
};




void setup()
{
  lcd.begin(16, 2);
  pinMode(switchPromptPin, INPUT);  //initialises button for prompts
  pinMode(switchMissionPin, INPUT);  //initialises button for missions
  pinMode(switchSet1Pin, INPUT);  //initialises button for switching to Set 1
  pinMode(switchSet2Pin, INPUT);  //initialises button for switching to Set 2
  pinMode(switchSet3Pin, INPUT);  //initialises button for switching to Set 3
}


void loop()
{
  //reads the state of the buttons
  switchPromptState = digitalRead(switchPromptPin);
  switchMissionState = digitalRead(switchMissionPin);
  switchSet1State = digitalRead(switchSet1Pin);
  switchSet2State = digitalRead(switchSet2Pin);
  switchSet3State = digitalRead(switchSet3Pin);



  lcd.scrollDisplayLeft();
  lcd.scrollDisplayLeft();


  if (switchSetValue == 0){ //Display upon start
    lcd.print(" Welcome! ");
  }


  if (switchSet1State == 1){  //Set 1 button is pressed
    switchSetValue = 1;
    lcd.clear();
    lcd.setCursor(0,0);
    lcd.print("COEX Mall, Seoul, Korea 4:15pm");
  }


  if (switchSet2State == 1){  //Set 2 button is pressed
    switchSetValue = 2;
    lcd.clear();
    lcd.setCursor(0,0);
    lcd.print("Opera House, Sydney, Australia 10:03am");
  }


  if (switchSet3State == 1){  //Set 3 button is pressed
    switchSetValue = 3;
    lcd.clear();
    lcd.setCursor(0,0);
    lcd.print("Shinjuku, Tokyo, Japan 7:04pm");
  }


  delay(600);


// When using Set 1
  if (switchPromptState == 1 && switchSetValue == 1){ //button on pin 2 is pressed
    lcd.clear();
    lcd.setCursor(0,0);
    lcd.print(prompts1[switchPrompt1Index]);


    switchPrompt1Index++;
    if(switchPrompt1Index >= 4){ //*change the number according to number of entries
      switchPrompt1Index = 0;
    }
    delay(300);
  }
 
  if (switchMissionState == 1 && switchSetValue == 1){ //button on pin 8 is pressed
    lcd.clear();
    lcd.setCursor(0,0);
    lcd.print(missions1[switchMission1Index]);


    switchMission1Index++;
    if(switchMission1Index >= 4){ //*change the number according to number of entries
      switchMission1Index = 0;
    }
    delay(300);
  }


// When using Set 2
  if (switchPromptState == 1 && switchSetValue == 2){
    lcd.clear();
    lcd.setCursor(0,0);
    lcd.print(prompts2[switchPrompt2Index]);


    switchPrompt2Index++;
    if(switchPrompt2Index >= 4){ //*change number according to number of entries
      switchPrompt2Index = 0;
    }
    delay(300);
  }
 
  if (switchMissionState == 1 && switchSetValue == 2){
    lcd.clear();
    lcd.setCursor(0,0);
    lcd.print(missions2[switchMission2Index]);


    switchMission2Index++;
    if(switchMission2Index >= 4){ //*change the number according to number of entries
      switchMission2Index = 0;
    }
    delay(300);
  }


// When using Set 3
  if (switchPromptState == 1 && switchSetValue == 3){
    lcd.clear();
    lcd.setCursor(0,0);
    lcd.print(prompts3[switchPrompt3Index]);


    switchPrompt3Index++;
    if(switchPrompt3Index >= 4){ //*change the number according to number of entries
      switchPrompt3Index = 0;
    }
    delay(300);
  }
 
  if (switchMissionState == 1 && switchSetValue == 3){
    lcd.clear();
    lcd.setCursor(0,0);
    lcd.print(missions3[switchMission3Index]);


    switchMission3Index++;
    if(switchMission3Index >= 4){ //*change the number according to number of entries
      switchMission3Index = 0;
    }
    delay(300);
  }
}
